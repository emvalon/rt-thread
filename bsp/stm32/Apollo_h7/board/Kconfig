## bsp/stm32/Apollo_h7/board/Kconfig
```kconfig
menu "Hardware Drivers Config"


menu "Select Chip"

	config SOC_STM32H743II
		bool "SOC_STM32H743II"
		select SOC_SERIES_STM32H7
		default y

	config SOC_STM32H763II
		bool "SOC_STM32H763II"
		select SOC_SERIES_STM32H7
		default n
endmenu

menu "Onboard Peripheral Drivers"

endmenu

menu "On-chip Peripheral Drivers"

    config BSP_USING_GPIO
        bool "Enable GPIO"
        select RT_USING_PIN
        default y
		
	menuconfig BSP_USING_QSPI
		bool "Enable QSPI"
		select RT_USING_QSPI
		default n
		
		if BSP_USING_QSPI
			config BSP_QSPI_USING_SOFTCS
			bool "Using Software Pin Control"
			default y
		endif
		
		
		
    menuconfig BSP_USING_UART
        bool "Enable UART"
        default y
        select RT_USING_SERIAL
        if BSP_USING_UART
            config BSP_USING_UART1
                bool "Enable UART1"
                default y

        endif
	
	menuconfig BSP_USING_PWM
		bool "Enable PWM"
		default n
		select RT_USING_PWM
		if BSP_USING_PWM
		menuconfig BSP_USING_PWM3
			bool "Enable timer3 output pwm"
			default n
			if BSP_USING_PWM3
				config BSP_USING_PWM3_CH4
					bool "Enable PWM3 channel_4"
					default n
			endif
		endif
		
	
		

endmenu

menu "Board extended module Drivers"

endmenu
 
endmenu
```
